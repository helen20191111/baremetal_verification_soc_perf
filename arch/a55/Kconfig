## arch/a55/Kconfig
```kconfig
# SPDX-License-Identifier: GPL-2.0
# Select 32 or 64 bit

config A55
	def_bool y
	select A55_TIMER_TEST
	select UART_TEST
	select GPIO_TEST

config 64BIT
	def_bool y


config CPU_BIG_ENDIAN
	bool "Enable Big Endian Mode"
    default n

config HAVE_STACKPROTECTOR
	bool "Enable HAVE_STACKPROTECTOR"
    default y

menu "A55 General option and module option"
	config SMP
		bool "Open SMP Test"

	config ENABLE_CACHE
		bool "Enable cache"
		default y

	source "module/Kconfig"
endmenu
```

## arch/a55/configs/bsta1000_defconfig
```kconfig
CONFIG_APP_JTAG=y
# CONFIG_ENABLE_CACHE is not set
CONFIG_DDR_TEST=y
CONFIG_IPC_TEST=y
CONFIG_DMAC_LLP_FUNC=y
CONFIG_I2C_TEST=y
CONFIG_I2C_BST_CORE=y
CONFIG_PRINT_UART_BAUD=115200
CONFIG_PWM_TEST=y
CONFIG_NOC_TEST=y
# CONFIG_STACKPROTECTOR is not set
CONFIG_CMD_I2C=y
CONFIG_CMD_DMAC=y
CONFIG_ERRNO_STR=y
CONFIG_FRAME_WARN=8192
```

## arch/r5_safety/Kconfig
```kconfig
# SPDX-License-Identifier: GPL-2.0

config R5_SAFETY
	def_bool y

config CPU_BIG_ENDIAN
	bool "Enable Big Endian Mode"
	default n


config HAVE_STACKPROTECTOR
	bool "Enable HAVE_STACKPROTECTOR"
	default y

menu "R5_SAFETY General option and module option"
	config R5B
		bool "R5B"

	source "module/Kconfig"
endmenu
```

## arch/r5_secure/Kconfig
```kconfig
# SPDX-License-Identifier: GPL-2.0

config R5_SECURE
	def_bool y

config CPU_BIG_ENDIAN
	bool "Enable Big Endian Mode"
	default n


config HAVE_STACKPROTECTOR
	bool "Enable HAVE_STACKPROTECTOR"
	default y

menu "R5_SECURE General option and module option"
	choice
		prompt "Secure release sequence"
		default NO_AUTO_RELEASE

	config RELEASE_A55
		bool "Secure only release a55"
		select DDR_TEST

	config RELEASE_R5_SAFETY
		bool "Secure only release r5 safety"

	config NO_AUTO_RELEASE
		bool "Secure no release anything"
		select DDR_TEST
	
	endchoice

	source "module/Kconfig"
endmenu
```

## cmd/Kconfig
```kconfig
# SPDX-License-Identifier: GPL-2.0

menu "Module commands"

config CMD_OLD_CLI
    bool "Compatible with the old command line interface"
    default y
    help
        To be able to use the old test case, this configuration 
        makes it possible to use the old command line interface.
        
config CMD_GET_IPID
    bool "Get the id of all module IP, if possible"
    default y
    help
        In order to obtain the available IP in system startup 
        verification, the IP is confirmed to be available by 
        reading the module id.

config CMD_GPIO 
    bool "Gpio module test command" 
    default y 
    help 
        Set gpio pin input and output direction, output value,
        and see gpio status.

config CMD_UART 
    bool "Uart module test command" 
    default y 
    help
        Initialize uart module,	set baud rate, send and 
        receive data.

config CMD_I2C
    bool "i2c"
    help
        I2C support

config CMD_ISP
    bool "ISP test command support"
    select COREIP_ISP_TEST
    help
        isp support

config CMD_VSP
    bool "VSP test command support"
    select COREIP_VSP_TEST
    help
        vsp support

config CMD_MEMORY
	bool "md, mw, cp, cmp, base"
	default y
	help
	  Memory commands.
	    md - memory display
	    mw - memory write (fill)
	    cp - memory copy
	    cmp - memory compare
	    base - print or set address offset

config CMD_DMAC
    bool "dmac command support"
    select DMAC
    select GDMA_TEST
    depends on !ENABLE_CACHE

 config CMD_SOC_PERF
     bool "soc perf"
     help
         soc perf support

endmenu
```

## common/Kconfig
```kconfig
# SPDX-License-Identifier: GPL-2.0

menu "Common options"

menu "Command line interface"

config CMDLINE
	bool "Support commands base on U-Boot"
	default y
	help
	  Enable U-Boot's command-line functions. This provides a means
	  to enter commands into U-Boot for a wide variety of purposes. It
	  also allows scripts (containing commands) to be executed.
	  Various commands and command categorys can be indivdually enabled.
	  Depending on the number of commands enabled, this can add
	  substantially to the size of U-Boot.

config CMDLINE_EDITING
	bool "Enable command line editing"
	depends on CMDLINE
	default y
	help
	  Enable editing and History functions for interactive command line
	  input operations

config AUTO_COMPLETE
	bool "Enable auto complete using TAB"
	depends on CMDLINE
	default y
	help
	  Enable auto completion of commands using TAB.

config SYS_LONGHELP
	bool "Enable long help messages"
	depends on CMDLINE
	default y if CMDLINE
	help
	  Defined when you want long help messages included
	  Do not set this option when short of memory.

config SYS_PROMPT
	string "Shell prompt"
	default "[a55]# " if A55
	default "[safety]# " if R5_SAFETY
	default "[secure]# " if R5_SECURE
	default "# "
	help
	  This string is displayed in the command line to the left of the
	  cursor.

endmenu

endmenu

if CMDLINE
source "cmd/Kconfig"
endif
```

## lib/Kconfig
```kconfig
# SPDX-License-Identifier: GPL-2.0

menu "lib options"
config USE_TTY_IO
	bool "use tty io fo uart0 and uart1"
	default y

config ERRNO_STR
	bool "Enable function for getting errno-related string message"
	help
	  The function errno_str(int errno), returns a pointer to the errno
	  corresponding text message:
	  - if errno is null or positive number - a pointer to "Success" message
	  - if errno is negative - a pointer to errno related message

endmenu
```

## module/Kconfig
```kconfig
# SPDX-License-Identifier: GPL-2.0

menu "module option"
	config DDR_TEST
		bool "Open ddr test"
		help
			sdadad
	if DDR_TEST
	source "module/ddr/Kconfig"
	endif

	config IPC_TEST
		bool "Open ipc test"
	if IPC_TEST
	source "module/ipc/Kconfig"
	endif

	config A55_TIMER_TEST
		bool "Open a55 timer test"
		depends on A55
	if A55_TIMER_TEST
	source "module/a55_timer/Kconfig"
	endif

	config GDMA_TEST
		bool "Open gdma test"
		depends on A55
	if GDMA_TEST
	source "module/gdma/Kconfig"
	endif

	config I2C_TEST
		bool "Open i2c test"
		depends on !R5_SECURE
	if I2C_TEST
	source "module/i2c/Kconfig"
	endif

	config UART_TEST
		bool "Open UART test"
	if UART_TEST
	source "module/uart/Kconfig"
	endif

	config GPIO_TEST
		bool "Open GPIO test"
	if GPIO_TEST
	source "module/gpio/Kconfig"
	endif

	config WDT_TEST
		bool "Open WDT test"
	if WDT_TEST
	source "module/wdt/Kconfig"
	endif

	config PWM_TEST
		bool "Open PWM test"
	if PWM_TEST
	source "module/pwm/Kconfig"
	endif

	config NOC_TEST
		bool "Open NOC test"
	if NOC_TEST
	source "module/noc/Kconfig"
	endif

	config A55_INT_TEST
		bool "Open a55 interrupt test"
		depends on A55
	if A55_INT_TEST
	source "module/a55_int/Kconfig"
	endif

	config LSP_PARITY_TEST
		bool "Open lsp parity test"
		depends on R5_SAFETY
	if LSP_PARITY_TEST
	source "module/lsp_parity/Kconfig"
	endif

    config QSPI_TEST
       	bool "Open qspi test"
    if QSPI_TEST
    source "module/qspi/Kconfig"
    endif

	config COREIP_ISP_TEST
		bool "Open COREIP ISP test"
	if COREIP_ISP_TEST
	source "module/isp/Kconfig"
	endif

	config COREIP_VSP_TEST
		bool "Open COREIP VSP test"
	if COREIP_VSP_TEST
	source "module/vsp/Kconfig"
	endif
	
	if EVB
	source "module/clock/Kconfig"
	endif

	config SOC_PERF_TEST
		bool "Open SOC PERF test"
	if SOC_PERF_TEST
	source "module/soc_perf/Kconfig"
	endif

endmenu
```

## module/clock/Kconfig
```kconfig
# SPDX-License-Identifier: GPL-2.0

menu "Clock options"

config CLK_SETP_1
    bool "noc clock frequency up to working fre"
    default n

config CLK_SETP_2
    bool "ddr clock frequency up to working fre (200m to 800m)"
    depends on CLK_SETP_1

config CLK_SETP_3
    bool "cpu clock frequency up to working fre (25m to 1.4G)"
    depends on CLK_SETP_2

config CLK_SETP_4
    bool "peripherals clock frequency to working fre"
    depends on CLK_SETP_3

endmenu
```

## module/ddr/Kconfig
```kconfig
# SPDX-License-Identifier: GPL-2.0

menu "DDR Configure"

choice
	prompt "DDR init clock options"
	default DDR_1066

config DDR_1066
	bool "DDR init 1066 fre"

config DDR_3200
	bool "DDR init 3200 fre"

config DDR_3200_2D
	bool "DDR init 3200 2d fre"

endchoice

config DDR_QOS_3200
	bool "3200 (2d) fre use qos"
	default n
	depends on DDR_3200 || DDR_3200_2D

endmenu
```

## module/gdma/Kconfig
```kconfig
# SPDX-License-Identifier: GPL-2.0

menu "dma options"

config DMAC
    bool "Select DMAC module"
    default y

config DMAC_CHA_MAX
    int
    default 8
    depends on DMAC

config DMAC_LLP_FUNC
    bool "Select DMAC pll funcation"
    default n

endmenu
```

## module/i2c/Kconfig
```kconfig
# SPDX-License-Identifier: GPL-2.0

menu "I2c options"

config I2C_BST_CORE
    bool "bst i2c core"
    default n

config I2C_MAX_BUS_NUM
    int
    default 6

endmenu
```

## module/isp/Kconfig
```kconfig
# SPDX-License-Identifier: GPL-2.0

menu "ISP options"

config IRISCV_BOOT
	bool "Boot ISP RISCV enable."
	default n
	
endmenu
```

## module/soc_perf/Kconfig
```kconfig
# SPDX-License-Identifier: GPL-2.0

menu "soc perf Configure"

config SOC_PERF_TEST_NUM
	bool "SOC perf test num"
	default n

endmenu
```

## module/uart/Kconfig
```kconfig
# SPDX-License-Identifier: GPL-2.0

menu "UART options"

config PRINT_UART_BAUD
	int "print uart rate option"
	default 38400
	
endmenu
```

## module/vsp/Kconfig
```kconfig
# SPDX-License-Identifier: GPL-2.0

menu "VSP options"

config VRISCV_BOOT
	bool "Boot VSP RISCV enable."
	default n
	
endmenu
```

## test_bench/Kconfig
```kconfig
menu "Test bench options"
	config TEST_ZEMI3
		bool
		default n
	source "test_bench/src/xtors/Kconfig"
endmenu
```

## test_bench/src/xtors/Kconfig
```kconfig
menu "xtor select"
	config XTOR_UART
		bool "Configure xtor uart"
		default y
	if XTOR_UART
	source "test_bench/src/xtors/uart/Kconfig"
	endif

	config XTOR_I2C
		bool "Config xtor i2c"
		default n
	if XTOR_I2C
	source "test_bench/src/xtors/i2c/Kconfig"
	endif

endmenu
```

## test_bench/src/xtors/i2c/Kconfig
```kconfig
menu "Configure xort i2c"
	config I2C_SLAVE_GENERAL
		bool
		default n

	config I2C_MASTER_GENERAL
		bool
		default n

	config I2C_ADDR_7BIT
		bool "Configure i2c addr is 7 bit"
		default y

	config I2C0_SLAVE_INIT
		bool "i2c0 slave init"
		default y
		select I2C_SLAVE_GENERAL
	
	config I2C0_SLAVE_RUN
		bool "i2c0 slave run"
		default n
		depends on I2C0_SLAVE_INIT
	
	config I2C1_SLAVE_INIT
		bool "i2c1 slave init"
		default n

	config I2C1_SLAVE_RUN
		bool "i2c1 slave run"
		default n
		depends on I2C1_SLAVE_INIT

	config I2C2_SLAVE_INIT
		bool "i2c2 slave init"
		default n
		select I2C_SLAVE_GENERAL

	config I2C2_SLAVE_RUN
		bool "i2c2 slave run"
		default n
		depends on I2C2_SLAVE_INIT

	config I2C3_SLAVE_INIT
		bool "i2c3 slave init"
		default n
		select I2C_SLAVE_GENERAL

	config I2C3_SLAVE_RUN
		bool "i2c3 slave run"
		default n
		depends on I2C3_SLAVE_INIT
		
	config I2C4_SLAVE_INIT
		bool "i2c4 slave init"
		default n
		select I2C_SLAVE_GENERAL

	config I2C4_SLAVE_RUN
		bool "i2c4 slave run"
		default n
		depends on I2C4_SLAVE_INIT

	config I2C5_SLAVE_INIT
		bool "i2c5 slave init"
		default n
		select I2C_SLAVE_GENERAL

	config I2C5_SLAVE_RUN
		bool "i2c5 slave run"
		default n
		depends on I2C5_SLAVE_INIT

	config I2C0_MASTER_INIT
		bool "i2c0 master init"
		default y
		depends on !I2C0_SLAVE_INIT
		select UART3_SYNC
		select I2C_MASTER_GENERAL

	config I2C0_MASTER_RUN
		bool "i2c0 master run"
		default n
		depends on I2C0_MASTER_INIT

	config I2C1_MASTER_INIT
		bool "i2c1 master init"
		default n
		depends on !I2C1_SLAVE_INIT
		select UART3_SYNC
		select I2C_MASTER_GENERAL

	config I2C1_MASTER_RUN
		bool "i2c1 master run"
		default n
		depends on I2C1_MASTER_INIT
			
	config I2C2_MASTER_INIT
		bool "i2c2 master init"
		default n
		depends on !I2C2_SLAVE_INIT
		select UART3_SYNC
		select I2C_MASTER_GENERAL

	config I2C2_MASTER_RUN
		bool "i2c2 master run"
		default n
		depends on I2C2_MASTER_INIT

	config I2C3_MASTER_INIT
		bool "i2c3 master init"
		default n
		depends on !I2C3_SLAVE_INIT
		select UART3_SYNC

	config I2C3_MASTER_RUN
		bool "i2c3 master run"
		default n
		depends on I2C3_MASTER_INIT
		select UART3_SYNC
		select I2C_MASTER_GENERAL

	config I2C4_MASTER_INIT
		bool "i2c4 master init"
		default n
		depends on !I2C4_SLAVE_INIT
		select UART3_SYNC
		select I2C_MASTER_GENERAL

	config I2C4_MASTER_RUN
		bool "i2c4 master run"
		default n
		depends on I2C4_MASTER_INIT

	config I2C5_MASTER_INIT
		bool "i2c5 master init"
		default n
		depends on !I2C5_SLAVE_INIT
		select UART3_SYNC
		select I2C_MASTER_GENERAL

	config I2C5_MASTER_RUN
		bool "i2c5 master run"
		default n
		depends on I2C5_MASTER_INIT
endmenu
```

## test_bench/src/xtors/uart/Kconfig
```kconfig
menu "Configure xtor uart"
	config UART0_INIT
		bool "uart0 init"
		default y

	config UART0_RUN
		bool "uart0 run"
		default n
	
	config UART1_INIT
		bool "uart1 init"
		default y

	config UART1_RUN
		bool "uart1 run"
		default n
	
	config UART2_INIT
		bool "uart2 init"
		default y
	
	config UART3_INIT
		bool "uart3 init"
		default y

	config UART3_SYNC
		bool
		default n
		select UART3_INIT
endmenu
```
